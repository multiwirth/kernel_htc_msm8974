## drivers/i2c/chips/Kconfig
```kconfig
#
# Miscellaneous I2C chip drivers configuration
#
# *** DEPRECATED! Do not add new entries! See Makefile ***
#

menu "Miscellaneous I2C Chip support"

config SENSORS_AK8963_DOE_PLUS
	tristate "AK8963 compass support with DOE Plus"
	default n
	depends on I2C
	help
	  If you say yes here you get support for Asahi Kasei's
	  orientation sensor with DOE Plus.

config BOSCH_BMA250
        tristate "BMA250 acceleration sensor support"
	depends on I2C=y
	help
	  If you say yes here you get support for Bosch Sensortec's
	  acceleration sensors BMA250.

config INPUT_CAPELLA_CM3629
	tristate "CM3629 proximity and light sensor"
	help
	  Say Y here to enable the CM3629 Short Distance Proximity
	  Sensor with Ambient Light Sensor.

config CIR_ALWAYS_READY
        bool "BMA250 CIR Always Ready"
	default n
	help
	  Enable CIR Always Ready

endmenu
```
